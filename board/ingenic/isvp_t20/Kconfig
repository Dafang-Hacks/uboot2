## board/ingenic/isvp_t20/Kconfig
```kconfig
menu "XBurst Platforms"
	depends on ARCH_XBURST



config SYS_SOC
	default "t20" if SOC_T20

choice
	prompt "XBurst SoC select"

config SOC_T20
	bool "T20"
	help
	  This supports T20 family of microcontrollers.

endchoice

config SYS_BOARD
	default "isvp_t20" if SOC_T20

config SYS_VENDOR
	default "ingenic" if SOC_T20


config SPL_BUILD
	bool "SPL_BUILD"
	help
	  T20

config ENV_IS_IN_SPI_FLASH
	bool "ENV_IS_IN_SPI_FLASH"
	help
	  T20

config SYS_CONFIG_NAME
	default "isvp_t20"

choice
	prompt "Board select"

config TARGET_T20
	bool "T20"
	select CREATE_ARCH_SYMLINK
	depends on SOC_T20
	help
	  T20

endchoice

config SPL_SFC_SUPPORT
	bool "SPL_SFC_SUPPORT"
	help
	  T20

config ENV_IS_IN_SPI_FLASH
	bool "ENV_IS_IN_SPI_FLASH"
	help
	  T20

config SFC_NOR
	bool "SFC_NOR"
	help
	  T20

config JZ_MMC_MSC0
	bool "JZ_MMC_MSC0"
	help
	  T20

config DDR2_128M
	bool "DDR2_128M"
	help
	  T20




endmenu
```

## configs/isvp_t20_sfcnor_ddr128M_defconfig
```kconfig
CONFIG_MIPS=y
CONFIG_ARCH_XBURST=y
CONFIG_SOC_T20=y
CONFIG_TARGET_T20=y
CONFIG_SYS_TEXT_BASE=0x80100000

CONFIG_SPL_SFC_SUPPORT=y
CONFIG_ENV_IS_IN_SPI_FLASH=y
CONFIG_SFC_NOR=y
CONFIG_JZ_MMC_MSC0=y
CONFIG_DDR2_128M=y
```
